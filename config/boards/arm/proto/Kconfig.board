## config/boards/arm/proto/Kconfig.board
```kconfig
#
# Copyright (c) 2021 The ZMK Contributors
# SPDX-License-Identifier: MIT
#

config BOARD_PROTO_LEFT
	bool "proto_left"
	depends on SOC_NRF52840_QIAA

config BOARD_PROTO_RIGHT
	bool "proto_right"
	depends on SOC_NRF52840_QIAA
```

## config/boards/arm/proto/Kconfig.defconfig
```kconfig
#
# Copyright (c) 2021 The ZMK Contributors
# SPDX-License-Identifier: MIT
#

if BOARD_PROTO_LEFT

config ZMK_KEYBOARD_NAME
	default "Proto"

config ZMK_SPLIT_ROLE_CENTRAL
	default y

endif # BOARD_PROTO_LEFT


if BOARD_PROTO_LEFT || BOARD_PROTO_RIGHT

config BOARD
	default "proto"

config ZMK_SPLIT
	default y

config BT_CTLR
	default BT

if USB_DEVICE_STACK

config USB_NRFX
	default y

endif # USB_DEVICE_STACK

endif # BOARD_PROTO_LEFT || BOARD_PROTO_RIGHT
```
